## sdkconfig.defaults
```kconfig
CONFIG_ATCA_MBEDTLS_ECDSA=y
CONFIG_ATCA_MBEDTLS_ECDSA_SIGN=y
CONFIG_ATCA_MBEDTLS_ECDSA_VERIFY=y

CONFIG_ATECC608A_TCUSTOM=y
CONFIG_ATCA_I2C_SDA_PIN=5
CONFIG_ATCA_I2C_SCL_PIN=4
CONFIG_ATCA_I2C_ADDRESS=0x70

CONFIG_MBEDTLS_SECURITY_RISKS=y
CONFIG_MBEDTLS_ALLOW_UNSUPPORTED_CRITICAL_EXT=y

CONFIG_ESP_SYSTEM_PANIC_PRINT_HALT=y
CONFIG_ESPTOOLPY_FLASHSIZE_4MB=y
CONFIG_ESPTOOLPY_FLASHMODE_QIO=y
CONFIG_ESPTOOLPY_FLASHFREQ_80M=y

CONFIG_ESP_MAIN_TASK_STACK_SIZE=10240
```
